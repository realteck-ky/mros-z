## samples/manifest/west.yml
```yaml
manifest:
  projects:
    - name: zephyr
      url: https://github.com/zephyrproject-rtos/zephyr
      revision: v4.4.0
      path: zephyr
      clone-depth: 1
      import: true

    - name: zenoh-pico
      url: https://github.com/takasehideki/zenoh-pico.git
      revision: 1193d97a4d2e08e18df609e3f0bdcc4ab36f47e0
      path: modules/lib/zenoh-pico

  self:
    path: .
```

## west.yml
```yaml
manifest:
  projects:
    - name: zephyr
      url: https://github.com/zephyrproject-rtos/zephyr
      revision: v4.4.2
      path: zephyr
      clone-depth: 1
      import: true

    - name: zenoh-pico
      url: https://github.com/takasehideki/zenoh-pico
      revision: 1193d97a4d2e08e18df609e3f0bdcc4ab36f47e0
      path: modules/lib/zenoh-pico

  self:
    path: modules/lib/mros-z
```

## zephyr/Kconfig
```kconfig
# Copyright (c) 2026 The mROS Z Contributors
# SPDX-License-Identifier: Apache-2.0

config MROS_Z
	bool "Enable mROS Z"
	help
	  This option enables the mROS Z as a Zephyr module.
```
