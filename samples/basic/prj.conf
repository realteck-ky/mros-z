## CMakeLists.txt
```
cmake_minimum_required(VERSION 3.20.0)

find_package(Zephyr REQUIRED HINTS $ENV{ZEPHYR_BASE})
project(mros_z_samples_basic)

target_sources(app PRIVATE src/main.cpp)
```

## west.yml
```
manifest:
  projects:
    - name: zenoh-pico
      url: https://github.com/eclipse-zenoh/zenoh-pico
      revision: 1.10.0
      path: modules/lib/zenoh-pico

  self:
    path: .
```

## prj.conf
```kconfig
CONFIG_CPP=y
CONFIG_STD_CPP17=y

CONFIG_SERIAL=y
CONFIG_CONSOLE=y
CONFIG_STDOUT_CONSOLE=y

CONFIG_MROS_Z=y
```

## src/main.cpp
```c
#include <mros-z/mros-z.hpp>
#include <zephyr/kernel.h>

int main(void) {
  printk("Build check of the mROS-Z application.\n");
  mros_z::init();
  return 0;
}
```
