## CMakeLists.txt
```
cmake_minimum_required(VERSION 3.20.0)

find_package(Zephyr REQUIRED HINTS $ENV{ZEPHYR_BASE})
project(mros_z_samples_basic)

target_sources(app PRIVATE src/main.cpp)
```

## prj.conf
```kconfig
CONFIG_CPP=y
CONFIG_STD_CPP17=y

CONFIG_MROS_Z=y

CONFIG_NETWORKING=y
CONFIG_NET_IPV6=y
CONFIG_NET_IPV4=y
CONFIG_NET_ARP=y
CONFIG_NET_TCP=y
CONFIG_NET_UDP=y
CONFIG_NET_SOCKETS=y
CONFIG_NET_DHCPV4=y
CONFIG_NET_DHCPV4_OPTION_CALLBACKS=y
CONFIG_DNS_RESOLVER=y

CONFIG_ENTROPY_GENERATOR=y
CONFIG_TEST_RANDOM_GENERATOR=y

CONFIG_INIT_STACKS=y

CONFIG_NET_MGMT=y
CONFIG_NET_MGMT_EVENT=y

CONFIG_NET_LOG=y
CONFIG_LOG=y

CONFIG_SLIP_STATISTICS=n
CONFIG_NET_SHELL=y

# Added config for zenoh-pico
## ref: https://github.com/eclipse-zenoh/zenoh-pico/blob/1.8.0/zephyr/Kconfig.zenoh
CONFIG_ZENOH_PICO=y
CONFIG_ZENOH_PICO_MULTI_THREAD=y
CONFIG_ZENOH_PICO_PUBLICATION=y
CONFIG_ZENOH_PICO_SUBSCRIPTION=y
CONFIG_ZENOH_PICO_QUERY=y
CONFIG_ZENOH_PICO_QUERYABLE=y
CONFIG_ZENOH_PICO_LINK_TCP=y
CONFIG_ZENOH_PICO_SCOUTING=y
CONFIG_ZENOH_PICO_LINK_UDP_UNICAST=y
CONFIG_ZENOH_PICO_LINK_UDP_MULTICAST=y

## POSIX support is required by zenoh-pico Zephyr backend
CONFIG_POSIX_API=y
CONFIG_POSIX_THREADS=y
CONFIG_POSIX_THREADS_EXT=y
CONFIG_POSIX_TIMERS=y
CONFIG_POSIX_NETWORKING=y

## Resource size increases for zenoh-pico
CONFIG_MAIN_STACK_SIZE=4096
CONFIG_SYSTEM_WORKQUEUE_STACK_SIZE=4096
CONFIG_HEAP_MEM_POOL_SIZE=150000

### Network buffers
CONFIG_NET_PKT_RX_COUNT=16
CONFIG_NET_PKT_TX_COUNT=16
CONFIG_NET_BUF_RX_COUNT=80
CONFIG_NET_BUF_TX_COUNT=80
CONFIG_NET_CONTEXT_NET_PKT_POOL=y
CONFIG_NET_MAX_CONTEXTS=10

### POSIX object pools
CONFIG_POSIX_THREAD_THREADS_MAX=4
CONFIG_MAX_PTHREAD_MUTEX_COUNT=32
CONFIG_MAX_PTHREAD_COND_COUNT=8
CONFIG_POSIX_THREAD_KEYS_MAX=8
```

## src/main.cpp
```c
#include <mros-z/mros-z.hpp>
#include <zephyr/kernel.h>

int main(void) {
  printk("This is mROS Z sample app.\n");
  mros_z::init();
  return 0;
}
```
